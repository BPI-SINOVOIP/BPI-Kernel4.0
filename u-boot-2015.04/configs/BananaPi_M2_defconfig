## u-boot-2015.04/configs/BananaPi_M2_defconfig
```kconfig
CONFIG_SPL=y
CONFIG_SYS_EXTRA_OPTIONS="USB_EHCI,SUNXI_GMAC,RGMII,MACPWR=SUNXI_GPG(10)"
CONFIG_DEFAULT_DEVICE_TREE="sun6i-a31s-bananapi-m2"
CONFIG_FDTFILE="sun6i-a31s-bananapi-m2-plus.dtb"
CONFIG_ARM=y
CONFIG_ARCH_SUNXI=y
CONFIG_MACH_SUN6I=y
CONFIG_DRAM_CLK=432
CONFIG_DRAM_ZQ=123
CONFIG_AXP221_DCDC1_VOLT=3000
# Ethernet phy power
CONFIG_AXP221_DLDO1_VOLT=3000
CONFIG_AXP221_DLDO2_VOLT=2800
CONFIG_AXP221_DLDO3_VOLT=3300
# USB hub power
CONFIG_AXP221_DLDO4_VOLT=3300
# Wifi power
CONFIG_AXP221_ALDO1_VOLT=3300
CONFIG_AXP221_ALDO2_VOLT=2500
# No Vbus gpio for either usb
CONFIG_USB1_VBUS_PIN="PC27"
CONFIG_USB2_VBUS_PIN="PG11"
CONFIG_ETH_DESIGNWARE=y
```
